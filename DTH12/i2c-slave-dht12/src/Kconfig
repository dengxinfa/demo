## DTH12/i2c-slave-dht12/src/Kconfig
```kconfig
config I2C_SLAVE_DHT12
        tristate "DHT12 I2C driver"
        depends on I2C_CORE
        select I2C_GETDHT12
        help
          This is an I2C driver for dht12
```
